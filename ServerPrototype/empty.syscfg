/**
 * @cliArgs --board "/ti/boards/CC26X2R1_LAUNCHXL" --rtos "tirtos7" --product "simplelink_cc13xx_cc26xx_sdk@7.10.02.23"
 * @versions {"tool":"1.16.2+3028"}
 */

/**
 * Import the modules used in this configuration.
 */
const GPIO        = scripting.addModule("/ti/drivers/GPIO");
const GPIO1       = GPIO.addInstance();
const Power       = scripting.addModule("/ti/drivers/Power");
const Settings    = scripting.addModule("/ti/posix/tirtos/Settings");
const BIOS        = scripting.addModule("/ti/sysbios/BIOS");
const Event       = scripting.addModule("/ti/sysbios/knl/Event");
const Idle        = scripting.addModule("/ti/sysbios/knl/Idle", {}, false);
const Idle2       = Idle.addInstance();
const Mailbox     = scripting.addModule("/ti/sysbios/knl/Mailbox");
const Error       = scripting.addModule("/ti/sysbios/runtime/Error");
const SysCallback = scripting.addModule("/ti/sysbios/runtime/SysCallback");
const Timestamp   = scripting.addModule("/ti/sysbios/runtime/Timestamp");

/**
 * Write custom configuration values to the imported modules.
 */
GPIO1.$hardware = system.deviceData.board.components.LED_RED;
GPIO1.$name     = "CONFIG_GPIO_LED_0";

const CCFG              = scripting.addModule("/ti/devices/CCFG", {}, false);
CCFG.ccfgTemplate.$name = "ti_devices_CCFG_CCFGCC26XXTemplate0";

BIOS.assertsEnabled = false;
BIOS.heapBaseAddr   = "__primary_heap_start__";
BIOS.heapEndAddr    = "__primary_heap_end__";

const Hwi           = scripting.addModule("/ti/sysbios/family/arm/m3/Hwi", {}, false);
Hwi.enableException = false;

const Clock      = scripting.addModule("/ti/sysbios/knl/Clock", {}, false);
Clock.tickPeriod = 10;

const Timer = scripting.addModule("/ti/sysbios/family/arm/cc26xx/Timer", {}, false);

Idle2.$name   = "powerIdle";
Idle2.idleFxn = "Power_idleFunc";

const Semaphore            = scripting.addModule("/ti/sysbios/knl/Semaphore", {}, false);
Semaphore.supportsPriority = false;

const Swi         = scripting.addModule("/ti/sysbios/knl/Swi", {}, false);
Swi.numPriorities = 6;

const Task             = scripting.addModule("/ti/sysbios/knl/Task", {}, false);
Task.checkStackFlag    = false;
Task.defaultStackSize  = 512;
Task.idleTaskStackSize = 512;
Task.numPriorities     = 6;

Error.policy       = "Error_SPIN";
Error.printDetails = false;

const System           = scripting.addModule("/ti/sysbios/runtime/System", {}, false);
System.abortFxn        = "System_abortSpin";
System.exitFxn         = "System_exitSpin";
System.extendedFormats = "%f";
System.supportModule   = "SysCallback";

/**
 * These are the reserved peripherals and settings in this configuration
 */
const iGPIO1    = scripting.addPeripheral("GPIO");
iGPIO1.$numPins = 8;
iGPIO1.$name    = "KeypadGPIO";
const iGPIO2    = scripting.addPeripheral("GPIO");
iGPIO2.$numPins = 10;
iGPIO2.$name    = "LCDGPIO";

/**
 * Pinmux solution for unlocked pins/peripherals. This ensures that minor changes to the automatic solver in a future
 * version of the tool will not impact the pinmux you originally saw.  These lines can be completely deleted in order to
 * re-solve from scratch.
 */
GPIO1.gpioPin.$suggestSolution = "boosterpack.39";
Timer.rtc.$suggestSolution     = "RTC0";
iGPIO1["0"].$suggestSolution   = "boosterpack.26";
iGPIO1["1"].$suggestSolution   = "boosterpack.25";
iGPIO1["2"].$suggestSolution   = "boosterpack.24";
iGPIO1["3"].$suggestSolution   = "boosterpack.23";
iGPIO1["4"].$suggestSolution   = "boosterpack.6";
iGPIO1["5"].$suggestSolution   = "boosterpack.2";
iGPIO1["6"].$suggestSolution   = "boosterpack.5";
iGPIO1["7"].$suggestSolution   = "boosterpack.8";
iGPIO2["0"].$suggestSolution   = "boosterpack.37";
iGPIO2["1"].$suggestSolution   = "boosterpack.36";
iGPIO2["2"].$suggestSolution   = "boosterpack.31";
iGPIO2["3"].$suggestSolution   = "boosterpack.32";
iGPIO2["4"].$suggestSolution   = "boosterpack.11";
iGPIO2["5"].$suggestSolution   = "boosterpack.19";
iGPIO2["6"].$suggestSolution   = "boosterpack.10";
iGPIO2["7"].$suggestSolution   = "boosterpack.9";
iGPIO2["8"].$suggestSolution   = "boosterpack.30";
iGPIO2["9"].$suggestSolution   = "boosterpack.29";
